ORG 0000H
LJMP MAIN

ORG 000BH
LJMP INTERRUPT

ORG 0030H
;SETTING UP THE LCD
MAIN:			
MOV P0,#0FFH		;ADC ON
SETB P1.5			;SET P1.5
MOV A,#38H		;SELECTS LCD OF 2 ROWS
ACALL COMMAND	;CALL COMMAND STATEMENT
ACALL DELAY		;CALL DELAY STATEMENT
MOV A,#0EH		;DISPLAY AND CURSOR TURNED ON
ACALL COMMAND	;CALL COMMAND STATEMENT
ACALL DELAY		;CALL DELAY STATEMENT
MOV A,#01H		;CLEAR DISPLAY
ACALL COMMAND	;CALL COMMAND STATEMENT
ACALL DELAY		;CALL DELAY STATEMENT
MOV A,#080H		;START PRINTING DATA FROM THIS ADDRESS 
ACALL COMMAND	;CALL COMMAND STATEMENT
ACALL DELAY		;CALL DELAY STATEMENT
LJMP AGAIN1		;JUMP TO AGAIN1 STATEMENT


;SENDING DATA FROM 8051 TO LCD
COMMAND:	
MOV P2,A		;MOVE DATA FROM A TO P2
CLR P3.1		;SET RS TO COMMAND MODE
CLR P3.0		;SET RW TO WRITE MODE 
SETB P3.2		;SET ENABLE PIN OF LCD
ACALL DELAY	;CLEAR ENABLE PIN OF LCD
RET			;RETURN


DELAY:
MOV R3,#0FFH 				;MOVE 0FFH TO R3	
AGAIN : DJNZ R3, AGAIN		;DECREMENT R3 AND JUMP TO AGAIN STATEMENT, IF NOT ZERO
RET						;RETURN

;SETTING UP DATA TO BE DISPLAYED ON LCD
AGAIN1:
MOV A,#' '			;LEAVE A SPACE ON DISPLAY
ACALL LCDWRITE	;CALL LCDWRITE STATEMENT
ACALL DELAY		;CALL DELAY STATEMENT
MOV A,#'T'			;MOVE 'T' TO A
ACALL LCDWRITE	;CALL LCDWRITE STATEMENT
ACALL DELAY		;CALL DELAY STATEMENT
MOV A,#'E'			;MOVE 'E' TO A
ACALL LCDWRITE	;CALL LCDWRITE STATEMENT
ACALL DELAY		;CALL DELAY STATEMENT
MOV A,#'M'		;MOVE 'M' TO A
ACALL LCDWRITE	;CALL LCDWRITE STATEMENT
ACALL DELAY		;CALL DELAY STATEMENT
MOV A,#'P'			;MOVE 'P' TO A
ACALL LCDWRITE	;CALL LCDWRITE STATEMENT
ACALL DELAY		;CALL DELAY STATEMENT
MOV A,#'.'			;MOVE '.' TO A
ACALL LCDWRITE	;CALL LCDWRITE STATEMENT
ACALL DELAY		;CALL DELAY STATEMENT
MOV A,#' '			;LEAVE A SPACE ON DISPLAY
ACALL LCDWRITE	;CALL LCDWRITE STATEMENT
ACALL DELAY		;CALL DELAY STATEMENT
MOV A,#'R'			;MOVE 'R' TO A
ACALL LCDWRITE	;CALL LCDWRITE STATEMENT
ACALL DELAY		;CALL DELAY STATEMENT
MOV A,#'E'			;MOVE 'E' TO A
ACALL LCDWRITE	;CALL LCDWRITE STATEMENT
ACALL DELAY		;CALL DELAY STATEMENT
MOV A,#'G'			;MOVE 'G' TO A
ACALL LCDWRITE	;CALL LCDWRITE STATEMENT
ACALL DELAY		;CALL DELAY STATEMENT
MOV A,#'U'			;MOVE 'U' TO A
ACALL LCDWRITE	;CALL LCDWRITE STATEMENT
ACALL DELAY		;CALL DELAY STATEMENT
MOV A,#'L'			;MOVE 'L' TO A
ACALL LCDWRITE	;CALL LCDWRITE STATEMENT
ACALL DELAY		;CALL DELAY STATEMENT
MOV A,#'A'			;MOVE 'A' TO A
ACALL LCDWRITE	;CALL LCDWRITE STATEMENT
ACALL DELAY		;CALL DELAY STATEMENT
MOV A,#'T'			;MOVE 'T' TO A
ACALL LCDWRITE	;CALL LCDWRITE STATEMENT
ACALL DELAY		;CALL DELAY STATEMENT
MOV A,#'O'			;MOVE 'O' TO A
ACALL LCDWRITE	;CALL LCDWRITE STATEMENT
ACALL DELAY		;CALL DELAY STATEMENT
MOV A,#'R'			;MOVE 'R' TO A
ACALL LCDWRITE	;CALL LCDWRITE STATEMENT
ACALL DELAY		;CALL DELAY STATEMENT
ACALL DELAY1		;CALL DELAY1 STATEMENT
LJMP AGAIN2		;CALL AGAIN2 STATEMENT

;SENDING THE DATA TO BE DISPLAYED
LCDWRITE:	
SETB P3.1		;SET RS TO DATA MODE
CLR P3.0		;SET RW TO WRITE MODE
SETB P3.2		;SET ENABLE PIN OF LCD
MOV P2, A		;MOVE DATA FROM A TO P2
ACALL DELAY	;CALL DELAY STATEMENT	
CLR P3.2		;CLEAR ENABLE PIN OF LCD
RET			;RETURN

DELAY1:                
MOV R3,#0FFH				;MOVE FFH TO R3		
HERE1: MOV R5,#0FFH		;MOVE FFH TO R5
HERE2: MOV 75H,#02FH		;MOVE 2FH TO 75H
HERE3: DJNZ 75H,HERE3		;DECREMENT 75H AND JUMP TO HERE3, IF NOT ZERO
HERE4: DJNZ R5,HERE2		;DECREMENT R5 AND JUMP TO HERE2 IF NOT ZERO
DJNZ R3,HERE1				;DECREMENT R3 AND JUMP TO HERE1 IF NOT ZERO
RET						;RETURN

;OBTAINING TEMPERATURE DATA
AGAIN2:
SETB P3.5				;SET P3.5
SETB P3.3				;READ MODE OF ADC IS TURNED OFF
CLR P3.4				;ADC STOPS CONVERTING A TO D	
SETB P3.4				;ADC STARTS CONVERTING A TO D
HERE5: JB P3.5,HERE5		;WHEN THERE ARE NO INTERRUPTS, JUMP OUT OF THE LOOP
CLR P3.3				;ADC START READING TEMPERATURE DATA
MOV A,#0C1H			;JUMP TO 2ND LINE ON LCD
ACALL COMMAND		;CALL COMMAND STATEMENT
ACALL DELAY			;CALL DELAY STATEMENT
MOV TMOD,#0AH		;TIMER 0 MODE 2
MOV IE,#82H			;ENABLE TIMER 0 INTERRUPT
MOV R1,P0				;MOVE DATA FROM P0 TO R1
MOV A,R1				;MOVE DATA FROM R1 TO A
MOV R4,A				;MOVE DATA FROM A TO R4
ACALL COMPARE		;CALL COMPARE STATEMENT
MOV A,R4				;MOVE DATA FROM R4 TO A
LCALL CONVERSION		;CALL CONVERSION STATEMENT
LCALL LCDWRITETMP	;CALL LCDWRITETMP STATEMENT
ACALL DELAY1			;CALL DELAY1
LJMP MAIN			;JUMP TO MAIN STATEMENT

;COMPARE TEMPERATURE VALUES
COMPARE:
CLR C				;CLEAR CARRY BIT
CJNE R1,#35,GAIN 		;COMPARE TEMP WITH 35C
GAIN: JNC GAIN1		;JUMP WHEN NO CARRY TO GAIN1
CLR C				;CLEAR CARRY BIT
CJNE R1,#25,GAIN2 		;COMPARE TEMP WITH 25C
GAIN2: JNC GAIN3 		;JUMP WHEN NO CARRY TO GAIN3
CLR TR0			 	;WHEN TEMPERATURE IS LESS THAN 25C, STOP FAN
LJMP GAIN4          		;JUMP TO GAIN4                  	  
GAIN1: ACALL GREATER	;CALL GREATER STATEMENT
LJMP GAIN4			;JUMP TO GAIN4
GAIN3: ACALL LOWER	;CALL LOWER STATEMENT
GAIN4: CLR C			;CLEAR CARRY BIT
RET					;RETURN

;IF THE ROOM TEMPERATURE IS LOWER THAN 35C & GREATER THAN 25C
LOWER:  
CLR TR0				;CLEAR TR0
MOV R2,#0AAH			;MOVE AAH TO R2
MOV TH0,#022H			;MOVE FEH TO TH0
SETB TR0				;START TIMER
RET					;RETURN

;IF THE ROOM TEMPERATURE IS HIGHER THAN 35C 
GREATER:               
CLR TR0				;CLEAR TR0
MOV R2,#0AAH			;MOVE AAH TO R2
MOV TH0,#0FEH			;MOVE 22H TO TH0
SETB TR0				;START TIMER
RET					;RETURN

CONVERSION:	
MOV B,#10		;MOVE 10 TO B
DIV AB		;DIVIDE A BY B
MOV R7,B		;MOVE DATA FROM B TO R7
MOV B,#10		;MOVE 10 TO B
DIV AB		;DIVIDE A BY B
MOV R6,B		;MOVE DATA FROM R6 TO B
MOV A,R6		;MOVE DATA FROM A TO R6
ADD A,#30H	;ADD 30H TO A
MOV R6,A		;MOVE DATA FROM R6 TO A
MOV A,R7		;MOVE DATA FROM R7 TO A
ADD A,#30H	;ADD 30H TO A
MOV R7,A		;MOVE DATA FROM A TO R7
RET			;RETURN

;SENDING THE TEMPERATURE VALUE TO LCD
LCDWRITETMP:
MOV A,R6			;MOVE DATA FROM R6 TO A
ACALL LCDWRITE	;CALL LCDWRITE STATEMENT
ACALL DELAY		;CALL DELAY STATEMENT
MOV A,R7			;MOVE DATA FROM R7 TO A
ACALL LCDWRITE	;CALL LCDWRITE STATEMENT
ACALL DELAY		;CALL DELAY STATEMENT
MOV A,#'C'			;MOVE 'C' TO A
ACALL LCDWRITE	;CALL LCDWRITE STATEMENT
ACALL DELAY		;CALL DELAY STATEMENT
RET				;RETURN

INTERRUPT:
CPL P1.5				;COMPLEMENT P1.5
CLR TR0				;CLEAR TR0
MOV 76H,R2			;MOVE DATA FROM R2 TO 76H
HERER: DJNZ 76H,HERER	;DECREMENT 76H AND JUMP TO HERER IF NOT ZERO
SETB TR0				;SET TR0
CPL P1.5				;COMPLEMENT P1.5
RETI     				;RETURN INTERRUPT

END
